## components/ssd1306/Kconfig.projbuild
```kconfig
menu "SSD1306 Configuration"

	config GPIO_RANGE_MAX
		int
		default 33 if IDF_TARGET_ESP32
		default 46 if IDF_TARGET_ESP32S2
		default 48 if IDF_TARGET_ESP32S3
		default 18 if IDF_TARGET_ESP32C2
		default 19 if IDF_TARGET_ESP32C3
		default 30 if IDF_TARGET_ESP32C6
		default 27 if IDF_TARGET_ESP32H2

	choice INTERFACE
		prompt "Interface"
		default I2C_INTERFACE
		help
			Select Interface.
		config I2C_INTERFACE
			bool "I2C Interface"
			help
				I2C Interface.
		config SPI_INTERFACE
			bool "SPI Interface"
			help
				SPI Interface.
	endchoice

	choice PANEL
		prompt "Panel Type"
		default SSD1306_128x64
		help
			Select Panel Type.
		config SSD1306_128x32
			bool "128x32 Panel"
			help
				Panel is 128x32.
		config SSD1306_128x64
			bool "128x64 Panel"
			help
				Panel is 128x64.
	endchoice

	config OFFSETX
		int "GRAM X OFFSET"
		range 0 99
		default 0
		help
			When your TFT have offset(X), set it.

	config FLIP
		bool "Flip upside down"
		default false
		help
			Flip upside down.

endmenu
```

## main/Kconfig.projbuild
```kconfig
menu "Application Configuration"

config APP_MAX30100_TEST
    bool "Build MAX30100 sensor test application"
    default n
    help
        When enabled the firmware builds a minimal application focused on the
        MAX30100 sensor. Only the I2C bus and the sensor driver are
        initialised and the application periodically prints the heart rate
        readings to the console. Disable this option to build the full EMS
        firmware.

config APP_MAX30100_TEST_SAMPLE_PERIOD_MS
    int "MAX30100 console update period (ms)"
    depends on APP_MAX30100_TEST
    range 10 5000
    default 10
    help
        Delay between consecutive sensor reads when the MAX30100 test
        application is enabled. Lower values provide faster updates but may
        produce more console output.

endmenu
```
